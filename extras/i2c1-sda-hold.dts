/dts-v1/;
/plugin/;

/*
 * RP1 I2C1 defaults to a 1-cycle (5 ns) SDA hold time, below the 300 ns
 * SMBus minimum; EMC2101 at 0x4C NACKs without this.
 */
/ {
	compatible = "brcm,bcm2712";

	fragment@0 {
		target = <&i2c1>;
		__overlay__ {
			i2c-sda-hold-time-ns = <300>;
		};
	};
};
